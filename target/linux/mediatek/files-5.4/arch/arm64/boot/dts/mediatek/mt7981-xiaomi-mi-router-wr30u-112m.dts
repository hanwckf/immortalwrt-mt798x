// SPDX-License-Identifier: GPL-2.0-or-later OR MIT

/dts-v1/;
#include "mt7981-xiaomi-mi-router-wr30u-base.dtsi"

/ { 
	model = "Xiaomi Mi Router WR30U (112M UBI layout)";
	compatible = "xiaomi,mi-router-wr30u-112m", "mediatek,mt7981";
};

&partitions {
	partition@600000 {
		label = "ubi";
		reg = <0x600000 0x7000000>;
	};
};
