## package/mtk/drivers/warp/config.in
```kconfig
if PACKAGE_kmod-warp

config WARP_VERSION
	int "WARP Driver HW Version Support"
	range 1 2
	default 1 if TARGET_mediatek_mt7622
	default 2 if TARGET_mediatek_mt7627

config WARP_ATC_SUPPORT
	bool "WARP Driver Address Translate Support for CR mirror"
	default y

config WARP_DBG_SUPPORT
	bool "WARP Driver Debug Info Support"
	default y

config WARP_WDMA_RECYCLE_SUPPORT
	bool "WARP WDMA Recycle Support"
	default n

config WED_HW_RRO_SUPPORT
	bool "WED HW RRO Support"
	default n

config MTK_MEMORY_SHRINK
	bool "Memory Shrink"
	default n

config WARP_MEMORY_LEAK_DBG
	bool "Memory leak debug"
	depends on !MTK_MEMORY_SHRINK && WARP_DBG_SUPPORT
	default y

config WARP_CHIPSET
	string "WARP target chipset"
	default colgin
	help
	For colgin: colgin, for panther: mt7986

config WARP_WO_EMBEDDED_LOAD
	bool "Emebedded MCU firmware support"
	default n
	help
	Once enabled, firmware download flow try embedded version once externel version being invalid.

endif
```

## package/mtk/drivers/wifi-profile/Config.in
```kconfig
menuconfig first_card
	bool "1st card"
	default y

if first_card

config first_card_name
	string "1st card name"
	default "MT7622"
endif

menuconfig second_card
	bool "2nd card"
	default n

if second_card

config second_card_name
	string "2nd card name"
	default "MT7615"
endif

menuconfig third_card
	bool "3rd card"
	default n

if third_card

config third_card_name
	string "3rd card name"
	default "MT7615"
endif

choice
	prompt "WiFi Setting"
	default WIFI_NORMAL_SETTING
	config WIFI_NORMAL_SETTING
		bool "normal setting"

	config WIFI_QUICK_SETTING
		bool "quick setting"

	help
		This is a way to configure wifi after wifi reload(Save & Apply from UI).
		Normal setting means reloading dat file which will execute "wifi down; wifi up"
		Quick setting means executing iwpriv commands corresponding to your operation on UI.
endchoice
```
